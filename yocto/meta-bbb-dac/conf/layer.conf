## yocto/meta-bbb-dac/conf/layer.conf
```bitbake
# We have a conf and classes directory, add to BBPATH
BBPATH .= ":${LAYERDIR}"

# We have recipes-* directories, add to BBFILES
BBFILES += "${LAYERDIR}/recipes-*/*/*.bb \
            ${LAYERDIR}/recipes-*/*/*.bbappend"

BBFILE_COLLECTIONS += "meta-bbb-dac"
BBFILE_PATTERN_meta-bbb-dac = "^${LAYERDIR}/"
BBFILE_PRIORITY_meta-bbb-dac = "6"

LAYERDEPENDS_meta-bbb-dac = "core"
LAYERSERIES_COMPAT_meta-bbb-dac = "warrior"
```

## yocto/meta-bbb-dac/conf/machine/bbb-dac.conf
```bitbake
#@TYPE: Machine
#@NAME: BeagleBone Black based DAC machine
#@DESCRIPTION: Machine configuration for Sven Schwermer's BeagleBone Black based DAC

DEFAULTTUNE ?= "armv7athf-neon"
require conf/machine/include/tune-cortexa8.inc

PREFERRED_PROVIDER_virtual/kernel = "linux-yocto"
PREFERRED_PROVIDER_virtual/bootloader = "u-boot"
PREFERRED_PROVIDER_u-boot = "u-boot"

KERNEL_IMAGETYPE = "zImage"
KERNEL_DEVICETREE = "bbb-dac.dtb"

UBOOT_ARCH = "arm"
UBOOT_MACHINE = "am335x_evm_config"
UBOOT_ENTRYPOINT = "0x80008000"
UBOOT_LOADADDRESS = "0x80008000"
SPL_BINARY = "MLO"
UBOOT_SUFFIX = "img"

UBI_VOLNAME = "rootfs"

EXTRA_IMAGEDEPENDS += "u-boot"

MACHINE_FEATURES = "usbgadget usbhost vfat ext2 screen alsa ethernet"
MACHINE_GUI_CLASS = "smallscreen"
MACHINE_ESSENTIAL_EXTRA_RRECOMMENDS = "kernel-modules"

SERIAL_CONSOLES = "115200;ttyS0"

WKS_FILE = "sdimage-bootpart.wks"

do_image_wic[depends] += "mtools-native:do_populate_sysroot dosfstools-native:do_populate_sysroot"
IMAGE_BOOT_FILES ?= "u-boot.${UBOOT_SUFFIX} ${SPL_BINARY}"
# wic.xz
IMAGE_FSTYPES += "tar.xz"
IMAGE_INSTALL_append = " kernel-devicetree kernel-image-zimage"
```
